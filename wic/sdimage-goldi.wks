## wic/sdimage-goldi.wks
```
# short-description: Create Raspberry Pi SD card image
# long-description: Creates a partitioned SD card image for use with
# Raspberry Pi. Boot files are located in the first vfat partition.

part /boot --source bootimg-partition --ondisk mmcblk0 --fstype=vfat --label boot --active --align 4096 --fixed-size 40
part / --source rootfs --ondisk mmcblk0 --fstype=ext4 --label A --align 4096 --fixed-size 300
part / --source rootfs --ondisk mmcblk0 --fstype=ext4 --label B --align 4096 --fixed-size 300
part /data --source dataimg-partition --ondisk mmcblk0 --fstype=ext4 --label data --align 4096 --fixed-size 256
```
